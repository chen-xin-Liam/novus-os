## Kconfig
```kconfig
# Novus OS - top-level Kconfig
#
# NOTE (M0): this file is a declaration-only placeholder. The M0 build
# system reads configs/novus_defconfig directly (plain shell-style
# variables); a Kconfig parser and menuconfig front-end will be added in
# a later milestone. Keep the entries below in sync with the defconfig.

config NOVUS_ARCH
	string
	default "x86_64"
	help
	  Target architecture Novus OS is built for.
	  M0 supports x86_64 only.

config NOVUS_MIN_MEMORY_MB
	int
	default 2048
	help
	  Minimum amount of guest/host memory (in MB) the kernel expects
	  to find at boot. Boot fails below this floor.

config NOVUS_BOOT_VGA
	bool
	default y
	help
	  Enable VGA text-mode output during early boot.

config NOVUS_DEBUG_SERIAL
	bool
	default y
	help
	  Enable serial (COM1) debug output. Useful when running under
	  QEMU with -serial stdio.

config NOVUS_BUILD_M0
	bool
	default y
	help
	  Selected when building the M0 milestone deliverables.

config NOVUS_A_CORE_DISABLE
	bool
	default n
	help
	  Disable the A core (BSP): it skips the early self-check and sleeps
	  right after firmware handoff, so the B core (AP) loads and runs
	  the main kernel. See README section 2.2 step 7; the matching
	  shared-memory flag can still be flipped at runtime by the M8
	  settings UI.

config NOVUS_SMP
	bool
	default y
	help
	  Enable SMP: assemble the 16-bit AP trampoline and wake the B core
	  during boot. 'make run' boots QEMU with -smp 2 (AB dual-core,
	  README part 2).

config NOVUS_NOVUSFS
	bool
	default y
	help
	  Build the NovusFS filesystem core (README part 4): superblock with
	  dual copies, block bitmap, inode table, directories and the
	  block-device ramdisk backend the M2 selftest formats.

config NOVUS_WAL
	bool
	default y
	help
	  Build the NovusFS write-ahead log (README 4.2.1): fixed circular
	  buffer, per-record CRC-32, commit markers and replay on mount.
	  Requires NOVUS_NOVUSFS.

config NOVUS_MERKLE
	bool
	default y
	help
	  Build the NovusFS integrity tree (README 4.2.2): a Merkle tree
	  over the bitmap, inode table and data area, whose root hash is
	  stored in both superblock copies. Verification happens in the boot
	  stage, before ExitBootServices, because that is the only phase
	  that can still read the real disk.
	  Requires NOVUS_NOVUSFS.

config NOVUS_NKM
	bool
	default y
	help
	  Build the Novus kernel module loader (README part 5): header
	  parsing, the zeroed-field SHA-256 digest and Ed25519 verification
	  against the built-in root keys. Unsigned or tampered modules are
	  refused, never fatal.

config NOVUS_INSTALLER
	bool
	default y
	help
	  Build the boot-stage installer: writes a GPT, an ESP and a
	  NovusFS system partition to a target disk and builds the Merkle
	  tree over the result. Requires NOVUS_MERKLE.

# User-space language modules live in their own trees and bring their own
# Kconfig with them, so the option is declared next to the code it builds.
source "user/mochi/Kconfig"

config NOVUS_SCHED
	bool
	default y
	help
	  Build the M4 ring-3 stack: GDT/TSS, IDT and exception handling,
	  the LAPIC timer, per-process address spaces, the syscall gate and
	  the NUC loader. The scheduler comes up on the B core; the A core
	  stays parked (README 2.2 step 6).

config NOVUS_DISPLAY
	bool
	default y
	help
	  Build NovusDisplay (README part 11): the Graphics Output Protocol
	  framebuffer HAL captured before ExitBootServices, the 2D software
	  renderer (rectangles, lines, circles, rounded shapes, alpha blend,
	  blitting, the built-in 5x7 font), PS/2 keyboard/mouse polling and
	  the M5 demo desktop. Without a usable linear framebuffer the VGA
	  text console stays active as the fallback.

config NOVUS_GUI
	bool
	default y
	depends on NOVUS_DISPLAY
	help
	  Build the NovusGUI widget library: window, panel, label, button,
	  checkbox, text box, slider, progress bar, list and tree. Requires
	  NOVUS_DISPLAY.

config NOVUS_IPC
	bool
	default y
	depends on NOVUS_SCHED
	help
	  Build the M6 message IPC: bounded per-port queues, the stamped
	  message header with its checksum, blocking receive that parks the
	  caller, and the ipc_* syscalls. Every task gets an inbox port named
	  by its pid. Requires NOVUS_SCHED.

config NOVUS_WM
	bool
	default y
	depends on NOVUS_GUI && NOVUS_IPC
	help
	  Build Novus-WM (README part 10): window objects with decorations,
	  z-order, focus, input routing, clipped compositing and the server
	  side of the GUI protocol on the well-known port "nwm". The timer
	  tick drives it instead of the M5 demo tick; the demo desktop stays
	  as the shell scene underneath. Requires NOVUS_GUI and NOVUS_IPC.
```

## user/Nuomi_pl/Kconfig
```kconfig
# Nuomi 语言模块配置（供 novus-os 顶层 Kconfig source）
# 合并位置：user/nuomi/（编译器+运行时）与 tools/nucutil/（主机端 NUC 工具）。

config USER_NUOMI
	bool "Nuomi language (Lisp-style, C impl) + NUC toolchain"
	default n
	help
	  Nuomi 是一门 Lisp 风格编程语言（树遍历解释器 + 引用计数 GC），
	  附带 novus-os NUC 原生格式（V1.0）的读写/校验/dump 工具链。
	  作为用户态语言模块，可将 .nuomi 源码编译为 NUC 原生可执行
	  （x86_64 机器码，对齐 NUC 规范 V1.0 的 .text 段）。
	  Windows 上 nucutil run 可做真机执行验证；其它平台仅 dump/validate。

config USER_NUOMI_NUCUTIL
	bool "nucutil (NUC format host tool)"
	default n
	depends on USER_NUOMI
	help
	  主机端工具：emit-demo / validate / dump / run NUC 文件。
	  用于构建期生成与校验 .nuc，便于打包进 novus-os 镜像。
```
